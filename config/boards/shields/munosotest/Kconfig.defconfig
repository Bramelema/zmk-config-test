## config/boards/shields/munosotest/Kconfig.defconfig
```kconfig
# Copyright (c) 2022 The ZMK Contributors
# SPDX-License-Identifier: MIT

if SHIELD_munosotest

config ZMK_KEYBOARD_NAME
    default "munosotest"

endif
```

## config/boards/shields/munosotest/Kconfig.shield
```kconfig
# Copyright (c) 2022 The ZMK Contributors
# SPDX-License-Identifier: MIT

config SHIELD_munosotest
    def_bool $(shields_list_contains,munosotest)
```
